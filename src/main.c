// ---------------------------------------------------------------------------
// Radio configuration mode (MAX2769B/C)
//
//   Default (macro left undefined): boot from the chip's preconfigured (OTP)
//   state. The SCLK/SDATA/CS pin levels select one of the 8 states in Table 3;
//   the levels driven below give state 2 - 16.368MHz reference, I channel only,
//   2-bit, CMOS outputs, 4.092MHz IF centre, 2.5MHz filter bandwidth.
//
//   Uncomment the line below: hold PGM low and program the registers over the
//   3-wire interface with setupRadio() - parallel I+Q outputs, 1-bit ADC,
//   4.2MHz filter bandwidth, IF centre trimmed to ~4.09MHz by TEST2/FCENMSB.
//   Register words are generated by doc/max2769_conf.py.
//
// #define TART_RADIO_SERIAL_CONFIG
// ---------------------------------------------------------------------------

// The system clock is selected by the SYSCLK macro that the PlatformIO ch32v
// platform injects for the board's f_cpu (see build_flags in platformio.ini).
#include <ch32v00x.h>
#include <debug.h>
#include "hardware.h"
#include "max2769.h"

void TART_Pin_Init() {

	GPIO_InitTypeDef GPIO_InitStructure = {0};

	/* RCC_APB2PeriphClockCmd(RCC_APB2Periph_GPIOA | RCC_APB2Periph_AFIO, ENABLE);
	GPIO_InitStructure.GPIO_Pin = TART_SCLK_PIN;
	GPIO_InitStructure.GPIO_Mode = GPIO_Mode_Out_PP;
	GPIO_InitStructure.GPIO_Speed = GPIO_Speed_50MHz;
	GPIO_Init(LED_GPIO_PORT, &GPIO_InitStructure); */

	RCC_APB2PeriphClockCmd(RCC_APB2Periph_GPIOD, ENABLE);
	GPIO_InitStructure.GPIO_Pin = TART_CS_PIN | TART_SDATA_PIN | TART_PGM_PIN | TART_SCLK_PIN | TART_SLOT_ENABLE_PIN;
	GPIO_InitStructure.GPIO_Mode = GPIO_Mode_Out_PP;
	GPIO_InitStructure.GPIO_Speed = GPIO_Speed_50MHz;
	GPIO_Init(TART_CS_PORT, &GPIO_InitStructure); 

	RCC_APB2PeriphClockCmd(RCC_APB2Periph_GPIOC, ENABLE);
	GPIO_InitStructure.GPIO_Pin = LED_GPIO_PIN;
	GPIO_InitStructure.GPIO_Mode = GPIO_Mode_Out_PP;
	GPIO_InitStructure.GPIO_Speed = GPIO_Speed_50MHz;
	GPIO_Init(LED_GPIO_PORT, &GPIO_InitStructure); 
}


void NMI_Handler(void) __attribute__((interrupt("WCH-Interrupt-fast")));
void HardFault_Handler(void) __attribute__((interrupt("WCH-Interrupt-fast")));
void Delay_Init(void);
void Delay_Ms(uint32_t n);

void pulse_led(uint32_t period, float high_percent) {
	if (high_percent < 0.0) high_percent = 0.0;
	if (high_percent > 1.0) high_percent = 1.0;
	uint32_t high_us = (period * high_percent);
	if (high_us > period) high_us = period;
	uint32_t low_us = period - high_us;
	// Drive the pin high for high_percent of the period. Assumes an active-high
	// LED; swap these two delays if the LED is wired to sink current instead.
	GPIO_WriteBit(LED_GPIO_PORT, LED_GPIO_PIN, Bit_SET);
	Delay_Us(high_us);
	GPIO_WriteBit(LED_GPIO_PORT, LED_GPIO_PIN, Bit_RESET);
	Delay_Us(low_us);
}

float qsin(float x) {
	// http://datagenetics.com/blog/july12019/index.html
	static const float pi = 3.14159265;
	static const float pis = pi*pi;
	static const float p2 = 2.0 * pi;

	// Wrap x to -pi..pi	
	while (x < -pi) x += p2;
	while (x > pi) x -= p2;
    if (x < 0) {
        return -qsin(-x);
	}
	float px = (pi - x);
	float xpx = x*px;
	float y = (16*xpx)/(5*pis - 4*xpx);

	return y;
}

float qcos(float x) {
	float x2 = x*x;
	float x4 = x2*x2;
	return 0.0372093273724708*x4 - 0.496392330120076*x2 + 0.999579515069198;
}
float qcos2(float x) {
	float c = qcos(x);
	return c*c;
}

int main(void)
{
	// The CH32V003 SDK only defines NVIC_PriorityGroup_0 and NVIC_PriorityGroup_1.
	NVIC_PriorityGroupConfig(NVIC_PriorityGroup_1);
	SystemCoreClockUpdate();
	Delay_Init();

	TART_Pin_Init();

	// SHDN the MAX2769 (Shutdown Mode)
	shutdownRadio();
	Delay_Ms(1500);

#ifdef TART_RADIO_SERIAL_CONFIG
	// Serial configuration mode: PGM low selects the 3-wire interface.
	GPIO_WriteBit(TART_PGM_PORT, TART_PGM_PIN, Bit_RESET);
	GPIO_WriteBit(TART_CS_PORT, TART_CS_PIN, Bit_SET);
	GPIO_WriteBit(TART_SDATA_PORT, TART_SDATA_PIN, Bit_RESET);
	GPIO_WriteBit(TART_SCLK_PORT, TART_SCLK_PIN, Bit_RESET);
	Delay_Ms(2000);
	// Enable the MAX2769 (Normal Mode)
	enableRadio();
	Delay_Ms(500);
	setupRadio(TART_CS_PORT, TART_CS_PIN);
	// setupRadioStream(TART_CS_PORT, TART_CS_PIN);  // DSP streaming variant:
	//   check SERCLK >= 2 x ADC clock first (see doc/max2769_conf.py, getCLK).
#else
	// Preconfigured (OTP) mode: drive the state-select pins first so they are
	// stable if the chip decodes the state on PGM's rising edge, then raise PGM.
	GPIO_WriteBit(TART_CS_PORT, TART_CS_PIN, Bit_RESET);     // CS   = 0
	GPIO_WriteBit(TART_SDATA_PORT, TART_SDATA_PIN, Bit_SET); // DATA = 1
	GPIO_WriteBit(TART_SCLK_PORT, TART_SCLK_PIN, Bit_RESET); // SCLK = 0 -> state 2
	Delay_Ms(10);
	GPIO_WriteBit(TART_PGM_PORT, TART_PGM_PIN, Bit_SET);
	Delay_Ms(2000);
	// Enable the MAX2769 (Normal Mode)
	enableRadio();
#endif

	while (1)
	{
		float scale = 3.14159265/256.0;

  		for (int j=-128; j<128; j++) {
			float theta = (float)(j)* scale;
			float y = qcos2(theta);

			pulse_led(10000, y);
		}
		for  (int j=0; j<128; j++) {
			pulse_led(10000, 0);
		}
	}
}

void NMI_Handler(void) {}
void HardFault_Handler(void)
{
	while (1)
	{
	}
}
